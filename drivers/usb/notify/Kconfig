## drivers/usb/notify/Kconfig
```kconfig
#
# USB notify configuration
#

comment "USB Notify features"
config USB_HOST_NOTIFY
	boolean "USB Host notify Driver (Old style)"
	depends on USB
	help
	  Android framework needs uevents for usb host operation.
	  Host notify Driver serves uevent format
	  that is used by usb host or otg.

config USB_NOTIFY_LAYER
	boolean "USB notify layer (New style)"
	depends on USB_SUPPORT && !USB_HOST_NOTIFY
	help
	  Added usb notify layer on gadget,host,otg drivers.
          The usb notify layer controls otg mode and vbus draw
          and vbus detect irq.

choice
	boolean "USB Notifier Adaptation"
	depends on USB_NOTIFY_LAYER

config USB_NOTIFIER_SLSI
	boolean "USB notifier for SLIS"
	help
	  Added platform driver to call usb notify.
	  The usb_notifier.c can be fixed for each models.

config USB_NOTIFIER_QCOM
	boolean "USB notifier for QCOM"
	help
	  Added platform driver to call usb notify.
	  The usb_notifier.c can be fixed for each models.

endchoice

config USB_HOST_NOTIFY_FEATURE
	boolean "NEW USB Host notify feature"
	depends on USB_NOTIFY_LAYER
	help
	  Android framework needs uevents for usb host operation.
	  Host notify Driver serves uevent format
	  that is used by usb host or otg.

config USB_DEBUG_DETAILED_LOG
	boolean "USB detailed log for debugging"
	depends on USB
	help
	  Add detailed log for debugging.
```

## security/mst_ftmdrv/Kconfig
```kconfig
#
config MST_FTM
	def_bool n

config MST_NOBLE_TARGET
	def_bool n
	bool "mst solution for noble target"

config MST_ZEN_TARGET
	def_bool n
	bool "mst solution for zen target"
```

## security/mstdrv/Kconfig
```kconfig
#
config MST_LDO
	def_bool n
	bool "Control MST LDO power source"

config MST_NOBLE_TARGET
	def_bool n
	bool "mst solution for noble target"

config MST_ZEN_TARGET
	def_bool n
	bool "mst solution for zen target"
```
